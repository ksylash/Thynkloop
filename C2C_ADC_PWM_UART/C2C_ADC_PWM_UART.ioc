# file: C2C_ADC_PWM_UART.ioc
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Mcu.Family=STM32F4
Mcu.Name=STM32F401R(B-C)Tx
Mcu.Package=LQFP64
NVIC.PriorityGroup=NVIC_PRIORITYGROUP_4
PC13-ANTI_TAMP.Signal=GPIO_Output
ProjectManager.HeapSize=0x200
ProjectManager.StackSize=0x400
ProjectManager.TargetToolchain=STM32CubeIDE
RCC.AHBFreq_Value=16000000
RCC.APB1Freq_Value=16000000
RCC.APB2Freq_Value=16000000
RCC.CortexFreq_Value=16000000
RCC.HSE_VALUE=25000000
RCC.HSI_VALUE=16000000
RCC.LSE_VALUE=32768
RCC.SYSCLKFreq_VALUE=16000000
RCC.VCOOutputFreq_Value=192000000
board=custom

// file: Core/Src/main.c
/* USER CODE BEGIN Header */
/**
 ******************************************************************************
 * @file           : main.c
 * @brief          : Main program body
 ******************************************************************************
 * @attention
 *
 * Copyright (c) 2025 STMicroelectronics.
 * All rights reserved.
 *
 * This software is licensed under terms that can be found in the LICENSE file
 * in the root directory of this software component.
 * If no LICENSE file comes with this software, it is provided AS-IS.
 *
 ******************************************************************************
 */
/* USER CODE END Header */
#include "main.h"

void SystemClock_Config(void);
static void MX_GPIO_Init(void);

/* USER CODE BEGIN 0 */

uint8_t rxData;

char buffer[100];
uint16_t timValue;

void UARTInit(void) {
	RCC->APB1ENR |= (1U << 17);	// USART2EN

	RCC->AHB1ENR |= (1U << 0);	// GPIOAEN
	GPIOA->MODER |= (2U << 4);	// PA2 - AF	Tx
	GPIOA->MODER |= (2U << 6);	// PA3 - AF	Rx
	GPIOA->AFR[0] |= (7U << 8);		//AF07
	GPIOA->AFR[0] |= (7U << 12);	//AF07

	USART2->BRR = (104U << 4) | (3U << 0); // USARTDIV = 9600
//	USART2->BRR = (8U << 4) | (11U << 0); // USARTDIV = 115200

	USART2->CR1 = (1U << 3) | (1U << 2);	// TE and RE
	USART2->CR1 |= (1U << 13);	// USARTEN
}

void UARTTransmit(uint8_t a_data) {
	while (!((1U << 7) & USART2->SR))
		;	//TXE

	USART2->DR = a_data;

	while (!((1U << 6) & USART2->SR))
		;	//TC
}

uint8_t UARTReceive(void) {
	while (!(USART2->SR & (1U << 5)))
		;	//RXNE

	return (USART2->DR);
}

uint32_t value = 0;

void ADCInit(void) {
	RCC->APB2ENR |= (1U << 8);

	RCC->AHB1ENR |= (1U << 0);

	GPIOA->MODER |= (3U << 0);

//	ADC1->CR1 &= (1U << 24);	//RES[25:24]
//	ADC1->CR1 &= (1U << 25);
	ADC1->CR1 = 0;

//	ADC1->CR2 &= (1U << 0);	//ADON -> OFF
	ADC1->CR2 = 0;

	ADC1->SQR3 = 0;	//SQ1[4:0] because Channel 0

	ADC->CCR = 0;	// ADCPRE[17:16] -> 00 makes pre-scalar divided by 2

	ADC1->CR2 = (1U << 0);	//ADC ON
}

uint32_t ADCRead(void) {
	ADC1->CR2 |= (1U << 30);	// SWSTART

	while (!(ADC1->SR & (1U << 1)))
		//EOC
		;

	return (ADC1->DR);
}

void timerInit(void) {
	RCC->APB1ENR |= (1U << 1);	//TIM3EN

	RCC->AHB1ENR |= (1U << 0);
	GPIOA->MODER |= (2U << 12);
//	GPIOA->AFR[0] |= (1U << 25);
	GPIOA->AFR[0] |= (2U << 24);

	TIM3->PSC = 15;	//16 000 000 / 16 = 1 000 000

	TIM3->ARR = 1999;  // 1 000 000/ 20 00 = 500Hz -> 2ms

	//	TIM3->PSC = 15;	//16 000 000 / 16 = 1 000 000
//
//	TIM3->ARR = 19999;  // 1 000 000/ 20 000 = 50Hz -> 20ms

	TIM3->CCR1 = 0;	// PWM = CCR1/ARR

	TIM3->CCMR1 = 0;	// Configured as output in bit 1:0
	TIM3->CCMR1 = (6U << 4);	//PWM mode 1
	TIM3->CCMR1 |= (1U << 3);	//OC preload enable

	TIM3->CCER |= (1U << 0);	//CC1E

	TIM3->CR1 |= (1U << 7);	//ARPE

	TIM3->CR1 |= (1U << 0);	//Timer/Counter enable
}

void setDuty(uint16_t args) {
	TIM3->CCR1 = args;
}

/* USER CODE END 0 */

int main(void) {

	/* MCU Configuration--------------------------------------------------------*/

	/* Reset of all peripherals, Initializes the Flash interface and the Systick. */
	HAL_Init();

	/* Configure the system clock */
	SystemClock_Config();

	/* Initialize all configured peripherals */
	MX_GPIO_Init();
	/* USER CODE BEGIN 2 */

	UARTInit();
	timerInit();
	ADCInit();

	/* USER CODE END 2 */

	/* Infinite loop */
	while (1) {

		/* USER CODE BEGIN 3 */
//		rxData = UARTReceive();
//		HAL_Delay(10);
//		UARTTransmit(rxData);
		value = ADCRead();
		HAL_Delay(5);
		timValue = (uint16_t) ((2000.0 / 4095.0) * value);
		TIM3->CCR1 = timValue;

//		uint8_t a = UARTReceive();
//		uint8_t b = UARTReceive();
//		uint16_t c = (a << 8) | b;
//
//		TIM3->CCR1 = c;

//		for (int i = 0; i < 2000; i += 1) {
//			TIM3->CCR1 = i;
//			HAL_Delay(1);
//		}
//
//		for (int i = 2000; i > 0; i -= 1) {
//			TIM3->CCR1 = i;
//			HAL_Delay(1);
//		}
	}
	/* USER CODE END 3 */
}

void SystemClock_Config(void) {
	RCC_OscInitTypeDef RCC_OscInitStruct = { 0 };
	RCC_ClkInitTypeDef RCC_ClkInitStruct = { 0 };

	/** Configure the main internal regulator output voltage
	 */
	__HAL_RCC_PWR_CLK_ENABLE();
	__HAL_PWR_VOLTAGESCALING_CONFIG(PWR_REGULATOR_VOLTAGE_SCALE2);

	/** Initializes the RCC Oscillators according to the specified parameters
	 * in the RCC_OscInitTypeDef structure.
	 */
	RCC_OscInitStruct.OscillatorType = RCC_OSCILLATORTYPE_HSI;
	RCC_OscInitStruct.HSIState = RCC_HSI_ON;
	RCC_OscInitStruct.HSICalibrationValue = RCC_HSICALIBRATION_DEFAULT;
	RCC_OscInitStruct.PLL.PLLState = RCC_PLL_NONE;
	if (HAL_RCC_OscConfig(&RCC_OscInitStruct) != HAL_OK) {
		Error_Handler();
	}

	/** Initializes the CPU, AHB and APB buses clocks
	 */
	RCC_ClkInitStruct.ClockType = RCC_CLOCKTYPE_HCLK | RCC_CLOCKTYPE_SYSCLK
			| RCC_CLOCKTYPE_PCLK1 | RCC_CLOCKTYPE_PCLK2;
	RCC_ClkInitStruct.SYSCLKSource = RCC_SYSCLKSOURCE_HSI;
	RCC_ClkInitStruct.AHBCLKDivider = RCC_SYSCLK_DIV1;
	RCC_ClkInitStruct.APB1CLKDivider = RCC_HCLK_DIV1;
	RCC_ClkInitStruct.APB2CLKDivider = RCC_HCLK_DIV1;

	if (HAL_RCC_ClockConfig(&RCC_ClkInitStruct, FLASH_LATENCY_0) != HAL_OK) {
		Error_Handler();
	}
}

static void MX_GPIO_Init(void) {
	GPIO_InitTypeDef GPIO_InitStruct = { 0 };

	/* GPIO Ports Clock Enable */
	__HAL_RCC_GPIOC_CLK_ENABLE();

	/*Configure GPIO pin Output Level */
	HAL_GPIO_WritePin(GPIOC, GPIO_PIN_13, GPIO_PIN_RESET);

	/*Configure GPIO pin : PC13 */
	GPIO_InitStruct.Pin = GPIO_PIN_13;
	GPIO_InitStruct.Mode = GPIO_MODE_OUTPUT_PP;
	GPIO_InitStruct.Pull = GPIO_NOPULL;
	GPIO_InitStruct.Speed = GPIO_SPEED_FREQ_LOW;
	HAL_GPIO_Init(GPIOC, &GPIO_InitStruct);

}

void Error_Handler(void) {
	__disable_irq();
	while (1) {
	}
}
