# file: 6_SPI.ioc
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Mcu.Family=STM32F4
Mcu.Name=STM32F401R(B-C)Tx
Mcu.Package=LQFP64
NVIC.PriorityGroup=NVIC_PRIORITYGROUP_4
ProjectManager.HeapSize=0x200
ProjectManager.StackSize=0x400
ProjectManager.TargetToolchain=STM32CubeIDE
RCC.AHBFreq_Value=16000000
RCC.APB1Freq_Value=16000000
RCC.APB2Freq_Value=16000000
RCC.CortexFreq_Value=16000000
RCC.HSE_VALUE=25000000
RCC.HSI_VALUE=16000000
RCC.LSE_VALUE=32768
RCC.SYSCLKFreq_VALUE=16000000
RCC.VCOOutputFreq_Value=192000000
board=custom

// file: Core/Src/main.c
/* USER CODE BEGIN Header */
/**
 ******************************************************************************
 * @file           : main.c
 * @brief          : Main program body
 ******************************************************************************
 * @attention
 *
 * Copyright (c) 2025 STMicroelectronics.
 * All rights reserved.
 *
 * This software is licensed under terms that can be found in the LICENSE file
 * in the root directory of this software component.
 * If no LICENSE file comes with this software, it is provided AS-IS.
 *
 ******************************************************************************
 *
 *PA5 - SPI1_CLK
 *PA6 - SPI1_MISO
 *PA7 - SPI1_MOSI
 *
 */
/* USER CODE END Header */
#include "main.h"

void SystemClock_Config(void);

/* USER CODE BEGIN 0 */

void initSPI1(void) {
	// Enable GPIO

	RCC->AHB1ENR |= (1U << 0);
	GPIOA->MODER |= (2U << 10) | (2U << 12) | (2U << 14);
	GPIOA->AFR[0] |= (5U << 20) | (5U << 24) | (5U << 28);	// AF05

	// Set PA4 (CS) as Output
	GPIOA->MODER |= (1U << 8);

	RCC->APB2ENR |= (1U << 12);	//SPI1EN

	// Configure SPI1 as Master, Mode 0 (CPOL=0, CPHA=0)
	// The below code will also set the Bit1(CPOL) to 0 and Bit0(CPHA) to 0
	SPI1->CR1 = (1U << 2);	// MSTR -> Master Selection, 0: Slave, 1: Master

	SPI1->CR1 |= (1U << 8);	// Bit8 - SSI(Internal Slave Select)
	SPI1->CR1 |= (1U << 9);	// Bit9 - SSM(Software Slave Management)

	GPIOA->ODR |= (1U << 4);

	// Below sets BR to fPCLK/16
	SPI1->CR1 |= (5U << 3); //BR[2:0] -> Baud-rate control

	// Enable SPI
	SPI1->CR1 |= (1U << 6);	// SPE
}

void transmitSPI(uint8_t a_data) {
	while (!(SPI1->SR & (1U << 1)))
		;	// TXE

	SPI1->DR = a_data;

//	while (!(SPI1->SR & (1U << 7)))
//		;  // Wait for BSY to be cleared
}

uint8_t receiveSPI(void) {
	while (!(SPI1->SR & (1U << 0)))
		// Bit0 - RXNE
		;
	return SPI1->DR;
}

/* USER CODE END 0 */

int main(void) {

	/* MCU Configuration--------------------------------------------------------*/

	/* Reset of all peripherals, Initializes the Flash interface and the Systick. */
	HAL_Init();

	/* Configure the system clock */
	SystemClock_Config();

	/* Initialize all configured peripherals */
	/* USER CODE BEGIN 2 */
	initSPI1();

	/* USER CODE END 2 */

	/* Infinite loop */
	while (1) {

		/* USER CODE BEGIN 3 */

		GPIOA->ODR &= ~(1U << 4);  // Set CS low
		transmitSPI(0x55);
		HAL_Delay(1);
		GPIOA->ODR |= (1U << 4);   // Set CS high
	}
	/* USER CODE END 3 */
}

void SystemClock_Config(void) {
	RCC_OscInitTypeDef RCC_OscInitStruct = { 0 };
	RCC_ClkInitTypeDef RCC_ClkInitStruct = { 0 };

	/** Configure the main internal regulator output voltage
	 */
	__HAL_RCC_PWR_CLK_ENABLE();
	__HAL_PWR_VOLTAGESCALING_CONFIG(PWR_REGULATOR_VOLTAGE_SCALE2);

	/** Initializes the RCC Oscillators according to the specified parameters
	 * in the RCC_OscInitTypeDef structure.
	 */
	RCC_OscInitStruct.OscillatorType = RCC_OSCILLATORTYPE_HSI;
	RCC_OscInitStruct.HSIState = RCC_HSI_ON;
	RCC_OscInitStruct.HSICalibrationValue = RCC_HSICALIBRATION_DEFAULT;
	RCC_OscInitStruct.PLL.PLLState = RCC_PLL_NONE;
	if (HAL_RCC_OscConfig(&RCC_OscInitStruct) != HAL_OK) {
		Error_Handler();
	}

	/** Initializes the CPU, AHB and APB buses clocks
	 */
	RCC_ClkInitStruct.ClockType = RCC_CLOCKTYPE_HCLK | RCC_CLOCKTYPE_SYSCLK
			| RCC_CLOCKTYPE_PCLK1 | RCC_CLOCKTYPE_PCLK2;
	RCC_ClkInitStruct.SYSCLKSource = RCC_SYSCLKSOURCE_HSI;
	RCC_ClkInitStruct.AHBCLKDivider = RCC_SYSCLK_DIV1;
	RCC_ClkInitStruct.APB1CLKDivider = RCC_HCLK_DIV1;
	RCC_ClkInitStruct.APB2CLKDivider = RCC_HCLK_DIV1;

	if (HAL_RCC_ClockConfig(&RCC_ClkInitStruct, FLASH_LATENCY_0) != HAL_OK) {
		Error_Handler();
	}
}

void Error_Handler(void) {
	__disable_irq();
	while (1) {
	}
}
