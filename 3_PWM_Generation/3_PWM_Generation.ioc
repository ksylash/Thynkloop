# file: 3_PWM_Generation.ioc
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Mcu.Family=STM32F4
Mcu.Name=STM32F401R(B-C)Tx
Mcu.Package=LQFP64
NVIC.PriorityGroup=NVIC_PRIORITYGROUP_4
ProjectManager.HeapSize=0x200
ProjectManager.StackSize=0x400
ProjectManager.TargetToolchain=STM32CubeIDE
RCC.48MHZClocksFreq_Value=48000000
RCC.AHBFreq_Value=16000000
RCC.APB1Freq_Value=16000000
RCC.APB1TimFreq_Value=16000000
RCC.APB2Freq_Value=16000000
RCC.APB2TimFreq_Value=16000000
RCC.CortexFreq_Value=16000000
RCC.HCLKFreq_Value=16000000
RCC.HSE_VALUE=25000000
RCC.HSI_VALUE=16000000
RCC.LSE_VALUE=32768
RCC.SYSCLKFreq_VALUE=16000000
RCC.VCOOutputFreq_Value=192000000
board=custom

// file: Core/Src/main.c
/* USER CODE BEGIN Header */
/**
 ******************************************************************************
 * @file           : main.c
 * @brief          : Main program body
 ******************************************************************************
 * @attention
 *
 * Copyright (c) 2025 STMicroelectronics.
 * All rights reserved.
 *
 * This software is licensed under terms that can be found in the LICENSE file
 * in the root directory of this software component.
 * If no LICENSE file comes with this software, it is provided AS-IS.
 *
 ******************************************************************************
 */
/* USER CODE END Header */
#include "main.h"

void SystemClock_Config(void);

/* USER CODE BEGIN 0 */

uint32_t value = 0;

void ADCInit(void) {
	RCC->APB2ENR |= (1U << 8);

	RCC->AHB1ENR |= (1U << 0);

	GPIOA->MODER |= (3U << 0);

//	ADC1->CR1 &= (1U << 24);	//RES[25:24]
//	ADC1->CR1 &= (1U << 25);
	ADC1->CR1 = 0;

//	ADC1->CR2 &= (1U << 0);	//ADON -> OFF
	ADC1->CR2 = 0;

	ADC1->SQR3 = 0;	//SQ1[4:0] because Channel 0

	ADC->CCR = 0;	// ADCPRE[17:16] -> 00 makes pre-scalar divided by 2

	ADC1->CR2 = (1U << 0);	//ADC ON
}

uint32_t ADCRead(void) {
	ADC1->CR2 |= (1U << 30);	// SWSTART

	while (!(ADC1->SR & (1U << 1)))
		//EOC
		;

	return (ADC1->DR);
}

void timerInit(void) {
	RCC->APB1ENR |= (1U << 1);	//TIM3EN

	RCC->AHB1ENR |= (1U << 0);
	GPIOA->MODER |= (2U << 12);
//	GPIOA->AFR[0] |= (1U << 25);
	GPIOA->AFR[0] |= (2U << 24);

	// For motor
//	TIM3->PSC = 15;	//16 000 000 / 16 = 1 000 000
//
//	TIM3->ARR = 19999;  // 1 000 000/ 20 000 = 50Hz -> 20ms

	TIM3->PSC = 15999;	//16 000 000 / 16 000= 1 000

	TIM3->ARR = 999;  // 1 000 000/ 1 000 = 1kHz -> 1ms

	TIM3->CCR1 = 0;	// PWM = CCR1/ARR

	TIM3->CCMR1 = 0;	// Configured as output in bit 1:0
	TIM3->CCMR1 = (6U << 4);	//PWM mode 1
	TIM3->CCMR1 |= (1U << 3);	//OC preload enable

	TIM3->CCER |= (1U << 0);	//CC1E

	TIM3->CR1 |= (1U << 7);	//ARPE

	TIM3->CR1 |= (1U << 0);	//Timer/Counter enable
}

void setDuty(uint16_t args) {
	TIM3->CCR1 = args;
}

/* USER CODE END 0 */

int main(void) {

	/* MCU Configuration--------------------------------------------------------*/

	/* Reset of all peripherals, Initializes the Flash interface and the Systick. */
	HAL_Init();

	/* Configure the system clock */
	SystemClock_Config();

	/* Initialize all configured peripherals */
	/* USER CODE BEGIN 2 */
	ADCInit();
	timerInit();
	/* USER CODE END 2 */

	/* Infinite loop */
	while (1) {

		/* USER CODE BEGIN 3 */
//		value = ADCRead();
//
//		setDuty(value / 1.638);
//		HAL_Delay(1000);
//		setDuty(1750);
//		HAL_Delay(1000);
//		setDuty(2500);
//		HAL_Delay(1000);
		for (int i = 0; i < 1000; i++) {
			TIM3->CCR1 = i;
			HAL_Delay(1);
		}

		for (int i = 1000; i > 0; i--) {
			TIM3->CCR1 = i;
			HAL_Delay(1);
		}
	}
	/* USER CODE END 3 */
}

void SystemClock_Config(void) {
	RCC_OscInitTypeDef RCC_OscInitStruct = { 0 };
	RCC_ClkInitTypeDef RCC_ClkInitStruct = { 0 };

	/** Configure the main internal regulator output voltage
	 */
	__HAL_RCC_PWR_CLK_ENABLE();
	__HAL_PWR_VOLTAGESCALING_CONFIG(PWR_REGULATOR_VOLTAGE_SCALE2);

	/** Initializes the RCC Oscillators according to the specified parameters
	 * in the RCC_OscInitTypeDef structure.
	 */
	RCC_OscInitStruct.OscillatorType = RCC_OSCILLATORTYPE_HSI;
	RCC_OscInitStruct.HSIState = RCC_HSI_ON;
	RCC_OscInitStruct.HSICalibrationValue = RCC_HSICALIBRATION_DEFAULT;
	RCC_OscInitStruct.PLL.PLLState = RCC_PLL_NONE;
	if (HAL_RCC_OscConfig(&RCC_OscInitStruct) != HAL_OK) {
		Error_Handler();
	}

	/** Initializes the CPU, AHB and APB buses clocks
	 */
	RCC_ClkInitStruct.ClockType = RCC_CLOCKTYPE_HCLK | RCC_CLOCKTYPE_SYSCLK
			| RCC_CLOCKTYPE_PCLK1 | RCC_CLOCKTYPE_PCLK2;
	RCC_ClkInitStruct.SYSCLKSource = RCC_SYSCLKSOURCE_HSI;
	RCC_ClkInitStruct.AHBCLKDivider = RCC_SYSCLK_DIV1;
	RCC_ClkInitStruct.APB1CLKDivider = RCC_HCLK_DIV1;
	RCC_ClkInitStruct.APB2CLKDivider = RCC_HCLK_DIV1;

	if (HAL_RCC_ClockConfig(&RCC_ClkInitStruct, FLASH_LATENCY_0) != HAL_OK) {
		Error_Handler();
	}
}

void Error_Handler(void) {
	__disable_irq();
	while (1) {
	}
}
